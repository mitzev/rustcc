## CMakeLists.txt
```
# Zephyr C++ interop probe — rustcc `class` under Zephyr RTOS.
#
# A Zephyr app whose `main` runs the four cross-compiler dispatch
# checks from examples/bare_metal_arm (Rust `class`, Rust subclass via
# a base pointer, Rust subclass of an IMPORTED g++-compiled base —
# override + inherited slot), proving the fork's vtables / ctor vptr
# install / cross-compiler RTTI work under Zephyr's build + runtime,
# not just the hand-rolled FreeRTOS one.
#
# The Rust side is the *same* validated crate as the FreeRTOS probe
# (examples/bare_metal_arm), built into libbare_metal_arm.a by
# run_zephyr.sh and passed in via -DRUSTCC_RUST_LIB. The C++ side
# (caller/sensor/rtti_stub) is reused byte-for-byte too.

cmake_minimum_required(VERSION 3.20.0)
find_package(Zephyr REQUIRED HINTS $ENV{ZEPHYR_BASE})
project(rustcc_zephyr_cpp C CXX)

set(BMA ${CMAKE_CURRENT_SOURCE_DIR}/../bare_metal_arm)

target_sources(app PRIVATE
  src/main.c
  ${BMA}/caller.cpp     # demo() entry points + placement-new + virtual calls
  ${BMA}/sensor.cpp     # the imported g++-compiled C++ base
  ${BMA}/rtti_stub.c    # __cxxabiv1 type_info vtables for the RTTI chain
)
target_include_directories(app PRIVATE ${BMA})

# Zephyr compiles C++ with -fno-rtti, but the imported base's typeinfo
# (`_ZTI6Sensor`) must exist for the fork-emitted `_ZTI6Reader` RTTI
# chain to resolve — so the TU that defines Sensor's vtable emits it
# with RTTI on (exactly as the FreeRTOS probe compiles sensor.cpp).
# The __si_class_type_info vtable it references comes from rtti_stub.c.
set_source_files_properties(${BMA}/sensor.cpp PROPERTIES COMPILE_OPTIONS "-frtti")

# Prebuilt Rust `class` staticlib (built for the Cortex-M3 target by
# run_zephyr.sh). caller.cpp references its init_*/ctor/vtable symbols,
# so the linker pulls the class metadata in.
if(NOT DEFINED RUSTCC_RUST_LIB)
  message(FATAL_ERROR "pass -DRUSTCC_RUST_LIB=/abs/path/libbare_metal_arm.a (see run_zephyr.sh)")
endif()
target_link_libraries(app PRIVATE ${RUSTCC_RUST_LIB})
```

## prj.conf
```kconfig
# Zephyr C++ interop probe config.
# C++17 on; RTTI/exceptions stay OFF (the cross-boundary RTTI rides
# the fork-emitted _ZTI metadata + rtti_stub.c, exactly as the
# FreeRTOS probe compiles caller.cpp with -fno-rtti -fno-exceptions).
CONFIG_CPP=y
CONFIG_STD_CPP17=y
CONFIG_PRINTK=y
CONFIG_MAIN_STACK_SIZE=4096
```

## boards/qemu_riscv32.overlay
```dts
/*
 * ESP32-C2 (ESP8684) ISA profile for the qemu_riscv32 board.
 *
 * The RAK11161's second core is the ESP8684 = ESP32-C2: RISC-V
 * rv32**imc** — NO atomic (A) and no float (F/D) extensions. The
 * stock qemu_riscv32 cpu@0 is rv32imafdc; override its extension list
 * to rv32imc. Zephyr derives BOTH the build ISA (soft-float,
 * software atomics) AND the qemu `-cpu` string from this devicetree
 * property (see boards/qemu/riscv32/board.cmake), so a single stray
 * `amo*`/`lr`/`sc` or hardware-float op would trap under qemu instead
 * of silently passing — the same ISA-exact guarantee the FreeRTOS
 * ESP32-C2 flavor gets from `-cpu rv32,a=false`.
 */
/ {
	cpus {
		cpu@0 {
			riscv,isa-extensions = "i", "m", "c", "zicsr", "zifencei";
		};
	};
};
```

## src/main.c
```c
/* Zephyr C++ interop probe (Cortex-M3, qemu_cortex_m3).
 *
 * Runs the four rustcc dispatch checks shared with
 * examples/bare_metal_arm — proving the fork's vtables, ctor vptr
 * install, and cross-compiler RTTI behave under Zephyr's build system
 * and runtime, not just a hand-rolled FreeRTOS image.
 */
#include <zephyr/kernel.h>
#include <zephyr/sys/printk.h>

/* C++ side (examples/bare_metal_arm/caller.cpp + the Rust class lib). */
extern int demo(int v);                       /* Rust base-class virtual      -> 105  */
extern int demo_subclass(int v, int scale);   /* Rust override via base ptr   -> 4000 */
extern int demo_imported_override(int id, int off); /* override imported base -> 503  */
extern int demo_imported_base(int id, int off);     /* inherited C++ slot     -> 42   */

int main(void)
{
	int got[4] = {
		demo(5),
		demo_subclass(3, 4),
		demo_imported_override(7, 3),
		demo_imported_base(7, 3),
	};
	static const int expected[4] = { 105, 4000, 503, 42 };

	for (int i = 0; i < 4; i++) {
		if (got[i] != expected[i]) {
			printk("ZEPHYR CXX PROBE: FAIL (check %d: got %d, want %d)\n",
			       i, got[i], expected[i]);
			return 0;
		}
	}
	printk("ZEPHYR CXX PROBE (%s): PASS "
	       "(105/4000/503/42 — class, subclass, imported override + inherited)\n",
	       CONFIG_BOARD);
	return 0;
}
```
